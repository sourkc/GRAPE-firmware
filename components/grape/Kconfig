## components/grape/Kconfig
```kconfig
menu "GRAPE"

    config GRAPE_GPU_MULTICORE
        bool "Use opportunistic Core 1 GPU tile worker"
        depends on !FREERTOS_UNICORE && !GRAPE_FUNCTION_PROFILING
        default y
        help
            Keep GPU command processing and the primary worker on Core 0.
            A priority-1 helper on Core 1 drains prepared MSAA tile jobs,
            below GFXLINK (4) and TinyUSB (5), and sleeps between batches.
            Disable for single-worker comparisons. Function profiling uses
            a single-writer table, so it retains the single-worker path.

    config GRAPE_MAX_DAMAGE_RECTS
        int "Maximum render damage rectangles"
        range 1 128
        default 16

    config GRAPE_DAMAGE_TILE_SIZE
        int "Damage tile size (pixels)"
        range 4 64
        default 16

    config GRAPE_DAMAGE_RECT_OVERHEAD_PIXELS
        int "Estimated fixed cost per render rectangle (pixel equivalents)"
        range 0 65536
        default 1024

    config GRAPE_FUNCTION_PROFILING
        bool "Enable automatic function call profiling"
        default n
        help
            Instrument GRAPE functions and count calls during benchmark
            measurement passes. This significantly changes benchmark timing,
            so timing results from profiling builds should not be compared with
            normal benchmark results.

    config GRAPE_FUNCTION_PROFILE_MAX_FUNCTIONS
        int "Maximum simultaneously profiled GRAPE functions"
        depends on GRAPE_FUNCTION_PROFILING
        range 64 4096
        default 1024
        help
            Number of unique function addresses the fixed profiling table can
            retain during one benchmark case.

    config GRAPE_TEXTURE_OCCUPANCY_CELL_SIZE
        int "Texture occupancy cell size (texels)"
        range 2 64
        default 8
        help
            A8 textures are scanned into a coarse occupancy bitmap using
            square cells of this size. Smaller cells give tighter damage
            coverage for rotated and irregular textures at higher CPU cost.

    choice GRAPE_TEXTURE_DEFAULT_MEMORY
        prompt "Default texture memory"
        default GRAPE_TEXTURE_DEFAULT_PSRAM

        config GRAPE_TEXTURE_DEFAULT_PSRAM
            bool "PSRAM"

        config GRAPE_TEXTURE_DEFAULT_INTERNAL
            bool "Internal RAM"
    endchoice

endmenu
```

## components/grape_display/Kconfig
```kconfig
menu "GRAPE display"

    config GRAPE_DISPLAY_DRIVER_WAVESHARE_P4_BSP
        bool "Waveshare ESP32-P4 BSP driver"
        default y

    config GRAPE_DISPLAY_DRIVER_NULL
        bool "Null display driver"
        default y

    choice GRAPE_DISPLAY_DEFAULT_DRIVER
        prompt "Default display driver"
        depends on GRAPE_DISPLAY_DRIVER_WAVESHARE_P4_BSP || GRAPE_DISPLAY_DRIVER_NULL
        default GRAPE_DISPLAY_DEFAULT_WAVESHARE_P4_BSP if GRAPE_DISPLAY_DRIVER_WAVESHARE_P4_BSP
        default GRAPE_DISPLAY_DEFAULT_NULL if GRAPE_DISPLAY_DRIVER_NULL

        config GRAPE_DISPLAY_DEFAULT_WAVESHARE_P4_BSP
            bool "Waveshare ESP32-P4 BSP"
            depends on GRAPE_DISPLAY_DRIVER_WAVESHARE_P4_BSP

        config GRAPE_DISPLAY_DEFAULT_NULL
            bool "Null"
            depends on GRAPE_DISPLAY_DRIVER_NULL
    endchoice

    config GRAPE_DISPLAY_BRIGHTNESS
        int "Initial display brightness"
        range 0 100
        default 100
        depends on GRAPE_DISPLAY_DRIVER_WAVESHARE_P4_BSP

    config GRAPE_NULL_DISPLAY_WIDTH
        int "Null display width"
        range 1 8192
        default 720
        depends on GRAPE_DISPLAY_DRIVER_NULL

    config GRAPE_NULL_DISPLAY_HEIGHT
        int "Null display height"
        range 1 8192
        default 1280
        depends on GRAPE_DISPLAY_DRIVER_NULL

    choice GRAPE_NULL_DISPLAY_FORMAT
        prompt "Null display format"
        default GRAPE_NULL_DISPLAY_RGB565
        depends on GRAPE_DISPLAY_DRIVER_NULL

        config GRAPE_NULL_DISPLAY_RGB565
            bool "RGB565"

        config GRAPE_NULL_DISPLAY_RGB888
            bool "RGB888"
    endchoice

endmenu
```

## sdkconfig.defaults
```kconfig
CONFIG_IDF_TARGET="esp32p4"
CONFIG_ESP32P4_SELECTS_REV_LESS_V3=y
CONFIG_ESPTOOLPY_FLASHSIZE_16MB=y
CONFIG_SPIRAM=y
CONFIG_SPIRAM_MODE_HEX=y
CONFIG_SPIRAM_SPEED_200M=y
CONFIG_SPIRAM_USE_MALLOC=y
CONFIG_BSP_LCD_TYPE_720_1280_9_INCH_B=y
CONFIG_BSP_LCD_COLOR_FORMAT_RGB565=y
CONFIG_BSP_LCD_DPI_BUFFER_NUMS=2
CONFIG_GRAPE_DISPLAY_DRIVER_WAVESHARE_P4_BSP=y
CONFIG_GRAPE_DISPLAY_DRIVER_NULL=y
CONFIG_GRAPE_DISPLAY_DEFAULT_WAVESHARE_P4_BSP=y
CONFIG_GRAPE_TEXTURE_DEFAULT_PSRAM=y
CONFIG_GRAPE_MAX_DAMAGE_RECTS=16
CONFIG_GRAPE_DAMAGE_TILE_SIZE=16
CONFIG_GRAPE_DAMAGE_RECT_OVERHEAD_PIXELS=1024
CONFIG_FATFS_LFN_HEAP=y
CONFIG_ESP_MAIN_TASK_STACK_SIZE=32768
CONFIG_ESP_TASK_WDT_TIMEOUT_S=60
CONFIG_TINYUSB_VENDOR_COUNT=1
CONFIG_TINYUSB_VENDOR_RX_BUFSIZE=32768
CONFIG_TINYUSB_VENDOR_TX_BUFSIZE=512
CONFIG_TINYUSB_VENDOR_EPSIZE=512
```
